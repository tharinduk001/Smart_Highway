#include <Wire.h>
#include <Adafruit_GFX.h>
#include <Adafruit_SSD1306.h>

// Vibration Pins
#define LED 13
#define Sensor 4
#define VCC 2
#define GND 3

// Constants
constexpr int RAIN_THRESHOLD = 500;
constexpr int OLED_RESET = -1; // OLED reset pin
constexpr int FRAME_DELAY = 42; // Animation speed
constexpr int WARNING_BLINK_DELAY = 700; // Blinking speed for the warning message
constexpr int FRAME_WIDTH = 32;
constexpr int FRAME_HEIGHT = 32;

// Messages
const String WarningMessage = "SLOW DOWN!";
const String RegularMessage = "NICE DAY!!";

// Global variables
Adafruit_SSD1306 HighwayDisplay(128, 64, &Wire, OLED_RESET);
const byte PROGMEM Rainframes[][128] = { 
  {0,0,0,0,0,0,0,0,0,0,0,0,0,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0,0},
  {0,0,0,0,0,0,0,0,0,0,0,0,0,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0,0},
  {0,0,0,0,0,0,0,0,0,0,0,0,0,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0,0},
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  {0,0,0,0,0,0,0,0,0,0,0,0,0,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0,0}
};
const byte PROGMEM Sunnyframes[][128] = {
  {0,0,0,0,0,0,0,0,0,0,0,0,0,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0,0},
  {0,0,0,0,0,0,0,0,0,0,0,0,0,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0,0},
  {0,0,0,0,0,0,0,0,0,0,0,0,0,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0,0},
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  {0,0,0,0,0,0,0,0,0,0,0,0,0,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0,0}
};
constexpr int FRAME_COUNT_RAIN = sizeof(Rainframes) / sizeof(Rainframes[0]);
constexpr int FRAME_COUNT_SUN = sizeof(Sunnyframes) / sizeof(Sunnyframes[0]);

int frame = 0;
bool isMessageVisible = true;
unsigned long lastBlinkTime = 0;
unsigned long lastFrameTime = 0;

void setup() {
    // Initialize the display
    HighwayDisplay.begin(SSD1306_SWITCHCAPVCC, 0x3C);
    HighwayDisplay.clearDisplay();
    HighwayDisplay.setTextSize(2);  // Set text size
    HighwayDisplay.setTextColor(WHITE); // Text color

    // Initialize Vibration Sensor/ LED
    pinMode(Sensor, INPUT);
    pinMode(LED, OUTPUT);
    pinMode(VCC, OUTPUT);
    digitalWrite(VCC, HIGH);
    pinMode(GND, OUTPUT);
    digitalWrite(GND, LOW);

}

void loop() {
    int sensorValue = analogRead(A0);
    unsigned long currentTime = millis();

    if (sensorValue < RAIN_THRESHOLD) {
        // Rain animation
        if (currentTime - lastFrameTime >= FRAME_DELAY) {
            updateRainAnimation();
            lastFrameTime = currentTime;
        }

        // Warning message blinking
        if (currentTime - lastBlinkTime >= WARNING_BLINK_DELAY) {
            updateWarningMessage();
            lastBlinkTime = currentTime;
        }

        HighwayDisplay.display(); // Refresh the display once per loop
    } else {
        // Sunny animation and regular message
        HighwayDisplay.clearDisplay();
        displayRegularMessage();
        updateSunnyAnimation();
        HighwayDisplay.display();
    }

    // Display vibration/collision detection
    bool value = digitalRead(Sensor);
    if (value == 1) {
        digitalWrite(LED,HIGH);
    } else if(value == 0){
        digitalWrite(LED,LOW);
    }

}

// Function Definitions

void updateWarningMessage() {
    if (isMessageVisible) {
        // Draw the warning message
        HighwayDisplay.setCursor(7, 0);
        HighwayDisplay.print(WarningMessage);
    } else {
        // Clear the warning message area
        HighwayDisplay.fillRect(7, 0, 120, 16, BLACK);
    }
    isMessageVisible = !isMessageVisible;
}

void displayRegularMessage() {
    HighwayDisplay.setCursor(7, 0);
    HighwayDisplay.print(RegularMessage);
}

void updateRainAnimation() {
    // Clear only the rain animation area
    HighwayDisplay.fillRect(48, 25, FRAME_WIDTH, FRAME_HEIGHT, BLACK);

    // Draw the current frame of the rain animation
    HighwayDisplay.drawBitmap(48, 25, Rainframes[frame], FRAME_WIDTH, FRAME_HEIGHT, 1);

    // Update the frame index
    frame = (frame + 1) % FRAME_COUNT_RAIN;
}

void updateSunnyAnimation() {
    // Draw the current frame of the sunny animation
    HighwayDisplay.drawBitmap(48, 25, Sunnyframes[frame], FRAME_WIDTH, FRAME_HEIGHT, WHITE);

    // Update the frame index
    frame = (frame + 1) % FRAME_COUNT_SUN;
}
